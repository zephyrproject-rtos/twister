## tests/data/common/testcase.yaml
```yaml
common:
  tags: kernel posix
  extra_configs:
      - CONFIG_POSIX_API=y
  filter: TOOLCHAIN_HAS_NEWLIB == 1
  min_ram: 32
tests:
  xyz.common_merge_1:
    tags: picolibc
    extra_configs:
      - CONFIG_NEWLIB_LIBC=y
    filter: CONFIG_PICOLIBC_SUPPORTED
    min_ram: 64
  xyz.common_merge_2:
    tags: arm
```

## tests/data/samples/bluetooth/sample.yaml
```yaml
tests:
  bluetooth.mesh.mesh_shell:
    platform_allow: qemu_cortex_m3 qemu_x86 nrf51dk_nrf51422
    platform_exclude: nrf52dk_nrf52810
    tags: bluetooth
    build_only: True
  bluetooth.mesh.mesh_shell.legacy_adv:
    platform_allow: qemu_cortex_m3
    extra_args: CONFIG_BT_EXT_ADV=n
    slow: True
    skip: True
```

## tests/data/tests/common/testcase.yaml
```yaml
common:
  tags: kernel posix
  extra_configs:
      - CONFIG_POSIX_API=y
  min_ram: 32
tests:
  xyz.common_merge_1:
    tags: picolibc
    extra_configs:
      - CONFIG_NEWLIB_LIBC=y
    min_ram: 64
  xyz.common_merge_2:
    tags: arm
```
